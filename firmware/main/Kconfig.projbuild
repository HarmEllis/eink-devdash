## firmware/main/Kconfig.projbuild
```kconfig
menu "DevDash Configuration"

config DEVDASH_DEMO_MODE
    bool "Demo mode (static dashboard data, no WiFi/API)"
    default n
    help
        Render a hardcoded sample dashboard once at boot, then keep the chip
        awake doing nothing. Skips NVS, WiFi provisioning, WiFi connect, and
        the API client entirely. Use this to demo the device to other people
        without needing network connectivity or configuration. Production
        builds must keep this disabled.

config DEVDASH_DEMO_PANEL_VARIANT
    int "Demo mode panel variant (0=BWR, 1=BW)"
    range 0 1
    default 0
    depends on DEVDASH_DEMO_MODE
    help
        Picks the e-paper panel variant the demo build runs against.
        Demo builds return before NVS / storage_load_v2() and so cannot
        consult cfg.panel_variant. This Kconfig drives the explicit
        display_set_panel_variant() call inside the demo block.
        0 = WeAct 2.9" BWR (default, preserves the current "BWR with red"
        demo appearance). 1 = WeAct 2.9" BW (collapses red operations
        to black via the lpix red-fold).

config DEVDASH_REFRESH_MIN
    int "Refresh interval (minutes)"
    range 3 60
    default 5
    help
        Default minutes between dashboard refreshes (deep-sleep duration).
        The provisioning portal may allow a 1-minute interval for the BW panel
        when at least two partial refreshes separate regular full refreshes.

config DEVDASH_DEFAULT_PANEL_VARIANT
    int "Default panel variant SKU (-1=unset, 0=BWR, 1=BW)"
    range -1 1
    default -1
    help
        Build-stamped panel SKU. Used as the panel variant when NVS has no
        real saved config yet (first boot / erased) and as the storage
        defaults / v2->v3 migration seed. A genuine saved v3 config (chosen
        via the provisioning portal) always wins over this value.

        This is the Gate 0.B fallback (see BOARD_NOTES): the panel-agnostic
        SAFE_BW bootstrap is not reliable on a red-preconditioned BWR panel,
        so the variant must be known at boot. Factory / SKU builds MUST set
        this to 0 (WeAct 2.9" BWR) or 1 (WeAct 2.9" BW). The firmware fails
        the build closed (#error) if it is left at -1; the repo dev / CI build
        sets 0 in sdkconfig.defaults.

        Wrong-SKU recovery: hold the BOOT button long enough to open the
        captive provisioning portal, then choose the correct panel variant
        under Display and save. The portal selector persists the choice in
        NVS and wins over the build-stamped default on subsequent boots.

config DEVDASH_PROV_TIMEOUT_S
    int "Provisioning timeout (seconds, 0 = no timeout)"
    range 0 3600
    default 0
    help
        How long to keep the device-hosted SoftAP HTTP provisioning portal
        open before giving up and going back to deep sleep. The default
        of 0 disables the timeout so the SoftAP stays available until the
        user saves credentials or power-cycles the device — required by
        the long-press recovery flow, where the device may have been
        running for a long time before the user reaches it.

config DEVDASH_BOOT_LONGPRESS_MS
    int "BOOT long-press duration (ms) to force provisioning portal"
    range 1000 15000
    default 5000
    help
        Holding the BOOT button (GPIO0) for this many milliseconds while
        the device is awake — or after waking from deep sleep — forces a
        reboot into the captive provisioning portal. The same threshold
        is re-verified after an EXT0 wake so a short press is treated as
        a refresh-only event and does not enter the portal.

config DEVDASH_WIFI_COUNTRY
    string "Default WiFi country code (regulatory domain)"
    default "01"
    help
        Built-in default two-letter ISO country code, applied via
        esp_wifi_set_country_code() until the user picks a region in the
        captive provisioning portal (the portal choice is persisted under its
        own NVS key and overrides this default — see storage_get_wifi_country).

        "01" is the world-safe default: it ships legally to any country. It
        makes channels 12-13 passive-only, so a router on auto-channel that
        lands on 13 is only reachable after the user selects their actual
        region in the portal (which they do during provisioning anyway).
        Setting a concrete region here (e.g. "NL") instead enables channels
        1-13 for active scan out of the box for single-region builds.

config DEVDASH_WIFI_CONNECT_TIMEOUT_S
    int "WiFi connect timeout (seconds)"
    range 5 120
    default 30
    help
        Maximum time spent trying one configured WiFi network before moving
        on to the next scanned candidate or reporting offline. The station
        may retry the same SSID within this window when association drops
        before DHCP completes.

config DEVDASH_RETRY_FOREVER_WHEN_OFFLINE
    bool "Retry forever when WiFi or API is unreachable"
    default n
    help
        Bring-up aid: when enabled, the device retries WiFi and API
        connection in a foreground loop instead of entering deep sleep on
        failure, so USB-CDC stays alive and the device remains flashable
        without a manual BOOT+RESET cycle. Default is off so production
        builds keep the battery-friendly deep-sleep-on-outage behavior.

config DEVDASH_OFFLINE_RETRY_INTERVAL_S
    int "Offline retry interval (seconds)"
    range 5 600
    default 30
    depends on DEVDASH_RETRY_FOREVER_WHEN_OFFLINE
    help
        Seconds to wait between retry attempts when WiFi or the API is
        unreachable and DEVDASH_RETRY_FOREVER_WHEN_OFFLINE is enabled.

config DEVDASH_OTA_THROTTLE_CYCLES
    int "OTA throttle cycles after a failed update attempt"
    range 0 100
    default 6
    help
        After a failed OTA manifest fetch or firmware download, skip this
        many subsequent wake cycles before trying again. At the default
        5-minute refresh interval this is ~30 minutes of back-off. The
        counter lives in RTC_NOINIT memory so it survives deep sleep but
        zeroes on cold boot or power loss. A successful update also
        zeroes it.

config DEVDASH_WARN_FULL_REFRESH_INTERVAL_S
    int "Warn when full e-paper refreshes are closer than this (seconds)"
    range 0 600
    default 180
    help
        Soft guardrail for the WeAct 2.9 inch e-paper panel. The firmware
        routes every full-panel refresh through a central helper and logs a
        warning when two full refreshes happen closer than this interval in
        the same wake cycle. OTA itself avoids extra redraws by design; this
        warning is for catching accidental retry-loop or multi-poster paths
        without blocking the UX for minutes.

menu "E-paper pin mapping"

config EINK_SPI_MOSI
    int "E-paper SPI MOSI GPIO"
    range 0 48
    default 11
    help
        SPI MOSI GPIO connected to the e-paper SDA pin.

config EINK_SPI_SCK
    int "E-paper SPI SCK GPIO"
    range 0 48
    default 12
    help
        SPI clock GPIO connected to the e-paper SCL pin.

config EINK_SPI_CS
    int "E-paper SPI CS GPIO"
    range 0 48
    default 10
    help
        SPI chip-select GPIO connected to the e-paper CS pin.

config EINK_DC_PIN
    int "E-paper D/C GPIO"
    range 0 48
    default 9
    help
        GPIO connected to the e-paper data/command pin.

config EINK_RST_PIN
    int "E-paper reset GPIO"
    range 0 48
    default 1
    help
        GPIO connected to the e-paper reset pin.

config EINK_BUSY_PIN
    int "E-paper busy GPIO"
    range 0 48
    default 13
    help
        GPIO connected to the e-paper busy pin.

endmenu

endmenu
```

## firmware/sdkconfig.defaults
```kconfig
# Flash
CONFIG_ESPTOOLPY_FLASHSIZE_4MB=y

# Partition layout: custom 2-slot OTA CSV (firmware/partitions.csv) so the
# device can pull OTA updates from the local API + GitHub Releases. ESP-IDF's
# stock TWO_OTA preset uses 1 MB slots plus a 1 MB factory partition; our
# binary is ~1.07 MB once esp_https_ota + the mbedtls cert bundle are linked
# in, so we ship a slightly larger 1.5 MB / 1.5 MB layout. Migrating from
# SINGLE_APP_LARGE shifts the app region, so the first install of an
# OTA-capable image triggers a webflasher erase prompt and the user
# re-provisions Wi-Fi + API token once. See docs/decisions/0005-ota-updates.md.
CONFIG_PARTITION_TABLE_CUSTOM=y
CONFIG_PARTITION_TABLE_CUSTOM_FILENAME="partitions.csv"

# OTA download path: bundled Mozilla root CAs so esp_https_ota can validate
# github.com / objects.githubusercontent.com without shipping a per-host PEM.
CONFIG_MBEDTLS_CERTIFICATE_BUNDLE=y

# Mark a newly OTA-installed image as PENDING_VERIFY at boot; firmware calls
# esp_ota_mark_app_valid_cancel_rollback() once a fetch + render succeeds.
# A crash/reset before that point reverts to the previous slot automatically.
CONFIG_BOOTLOADER_APP_ROLLBACK_ENABLE=y

# Main task stack: default 3584 B is for trivial main tasks. app_main here
# runs Wi-Fi setup, API fetch, JSON parse, and display rendering on the main
# task. 8 KiB matches typical ESP-IDF wifi-station examples and leaves room
# for the dashboard fetch/render path.
CONFIG_ESP_MAIN_TASK_STACK_SIZE=8192

# WiFi
CONFIG_ESP_WIFI_SOFTAP_SUPPORT=y

# ESP32-S3 Super Mini exposes the built-in USB-Serial-JTAG CDC port. We use it
# as a secondary log console so plugging USB gives the same log stream as a
# wired UART adapter. UART0 stays the primary console.
# CONFIG_ESP_CONSOLE_SECONDARY_NONE is not set
CONFIG_ESP_CONSOLE_SECONDARY_USB_SERIAL_JTAG=y

# Panel SKU. The repo dev / CI build targets the WeAct 2.9" BWR module (0).
# Per-SKU factory builds override this (0=BWR, 1=BW); see Gate 0.B in
# BOARD_NOTES. Leaving it at the Kconfig sentinel (-1) fails the build closed.
CONFIG_DEVDASH_DEFAULT_PANEL_VARIANT=0

# Deep sleep
CONFIG_PM_ENABLE=y
CONFIG_FREERTOS_USE_TICKLESS_IDLE=y

# NVS encryption off (home LAN use case)
CONFIG_NVS_ENCRYPTION=n

# SoftAP compatibility (ESP32-S3): Espressif's Wi-Fi FAQ recommends disabling
# AMPDU RX/TX to fix ESP32-S2/S3 SoftAP incompatibility with phones/PCs (a
# started-but-undetectable SoftAP). Paired with dropping the AP to 11b/g (no
# 11n/AMPDU) in run_provisioning_window. Negligible throughput impact for this
# low-bandwidth dashboard. See ESP-IDF issue #13508.
CONFIG_ESP_WIFI_AMPDU_TX_ENABLED=n
CONFIG_ESP_WIFI_AMPDU_RX_ENABLED=n

# HTTPD / provisioning portal
CONFIG_HTTPD_MAX_REQ_HDR_LEN=1024

# Task stacks bumped for the SoftAP captive-portal flow. Defaults are tuned
# for a station-only build; with SoftAP + DHCP server + captive DNS + httpd
# all active during provisioning, several tasks need more headroom. A
# context-switch StoreProhibited tracked back to a corrupted CP-save-area
# pointer (a task overflowed and trampled its own TCB metadata).
CONFIG_LWIP_TCPIP_TASK_STACK_SIZE=5120
CONFIG_ESP_IPC_TASK_STACK_SIZE=4096
CONFIG_ESP_SYSTEM_EVENT_TASK_STACK_SIZE=4096
CONFIG_ESP_TIMER_TASK_STACK_SIZE=4608

# Trace facility lets us call uxTaskGetSystemState() to log per-task stack
# high-water-marks during provisioning, so the next round of debugging can
# pinpoint the overflow culprit instead of guessing.
CONFIG_FREERTOS_USE_TRACE_FACILITY=y

# Log level
CONFIG_LOG_DEFAULT_LEVEL_INFO=y

# Demo
CONFIG_DEVDASH_DEMO_MODE=n
```

## firmware/sdkconfig.defaults.esp32s3
```kconfig
# ESP32-S3 Super Mini specifics
CONFIG_IDF_TARGET_ESP32S3=y
CONFIG_ESP32S3_DEFAULT_CPU_FREQ_240=y

# SPI pins — WeAct 2.9" e-paper wired to ESP32-S3 Super Mini
# SDA(MOSI)=GP11, SCL(SCK)=GP12, CS=GP10, D/C=GP9, RES=GP1, BUSY=GP13
# MISO unused (-1), VCC=3V3 (NOT 5V)
CONFIG_EINK_SPI_MOSI=11
CONFIG_EINK_SPI_SCK=12
CONFIG_EINK_SPI_CS=10
CONFIG_EINK_DC_PIN=9
CONFIG_EINK_RST_PIN=1
CONFIG_EINK_BUSY_PIN=13
```
